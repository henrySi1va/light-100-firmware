## CMakeLists.txt
```
cmake_minimum_required(VERSION 3.25.1)

find_package(Zephyr REQUIRED HINTS $ENV{ZEPHYR_BASE})
project(light-100)

target_sources(app PRIVATE 
    src/main.c
    src/tasks/task_logger.c
    src/tasks/task_temp.c
    src/drivers/temp_sim.c)

target_include_directories(app PRIVATE
    src/tasks
    src/drivers)
```

## prj.conf
```kconfig
CONFIG_STDOUT_CONSOLE=y
CONFIG_THREAD_NAME=y
CONFIG_SCHED_CPU_MASK=y
CONFIG_QEMU_ICOUNT=n
CONFIG_DEBUG=y
CONFIG_DEBUG_OPTIMIZATIONS=y
CONFIG_COMPILER_OPT="-Werror -Wall"
CONFIG_NEWLIB_LIBC=y
CONFIG_NEWLIB_LIBC_FLOAT_PRINTF=y
```

## src/main.c
```c
#include <zephyr/kernel.h>
#include <zephyr/sys/printk.h>

#define STACKSIZE 1024
#define PRIORITY 7
#define SLEEPTIME 1

void sound_thread_function(void) {
  printk("Hello Sound\n");
  k_sleep(K_SECONDS(5));
}

void logger_thread_function(void) {
  k_sleep(K_SECONDS(5));
  printk("Hello Logger\n");
}

K_THREAD_DEFINE(sound_thread, STACKSIZE, sound_thread_function, NULL, NULL,
                NULL, PRIORITY, 0, 100);
extern const k_tid_t sound_thread;

K_THREAD_DEFINE(logger_thread, STACKSIZE, logger_thread_function, NULL, NULL,
                NULL, PRIORITY, 0, 100);
extern const k_tid_t thread_b;

int main(void) { return 0; }
```
